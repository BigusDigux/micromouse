#include "OLED.h"
#include <stdio.h>

I2C_HandleTypeDef *OLED_hi2c;
#define DevAdd 0x78

static const uint8_t font5x7[][5] = {
		{0x00,0x00,0x00,0x00,0x00}, // space
		{0x00,0x00,0x5F,0x00,0x00}, // !
		{0x00,0x07,0x00,0x07,0x00}, // "
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		{0x10,0x08,0x08,0x10,0x08}  // ~
};

static const uint8_t Oled_InitCommand[] = {
		0x00,
		0xAE,       // Display off
		0xD5, 0x80, // Set display clock divide ratio/oscillator freq or 0xD5, 0xA0
		0xA8, 0x1F, // Set multiplex ratio (height - 1)
		0xD3, 0x00, // Display offset
		0x40,       // Set start line to 0
		0x8D, 0x14, // Enable charge pump
		0x20, 0x02, // Memory mode: horizontal addressing
		0xDA, 0x02, // COM pins configuration
		0xA1, 0xC8,
		0xAF        // Display ON
};

void OLED_Init(void){
	HAL_I2C_Master_Transmit(OLED_hi2c, DevAdd, (uint8_t *)Oled_InitCommand, sizeof(Oled_InitCommand), 500);
	HAL_Delay(1);
}

void OLED_Clear(void) {
    for (uint8_t page = 0; page < 4; page++) { // Với màn hình 128x32 thì có 4 page
        uint8_t cmd[] = {0x00, (uint8_t)(0xB0 + page), 0x00, 0x10};
        HAL_I2C_Master_Transmit(OLED_hi2c, DevAdd, cmd, sizeof(cmd), 500);

        uint8_t data[129]; // 1 byte control + 128 byte data
        data[0] = 0x40; // control byte cho dữ liệu
        for (int i = 1; i < 129; i++) data[i] = 0x00;

        HAL_I2C_Master_Transmit(OLED_hi2c, DevAdd, data, sizeof(data), 500);
    }
}


void OLED_Print(char *s, uint8_t row, uint8_t col) {
	uint8_t page[] = { 0x00, (uint8_t)(0xB0 + row), (uint8_t)(0x00 | (col & 0x0F)), (uint8_t)(0x10 | (col >> 4))};
	HAL_I2C_Master_Transmit(OLED_hi2c, DevAdd, (uint8_t *)page, sizeof(page), 500);

	while (*s) {
		uint8_t bytes[7];
		for (int i = 0; i < 5; i++) {
			   bytes[i+1] = font5x7[*s - 32][i];
		}
		bytes[0] = 0x40;
		bytes[6] = 0x00;
		HAL_I2C_Master_Transmit(OLED_hi2c, DevAdd, bytes, sizeof(bytes), 500);
		s++;
		col+=6;
	}
	uint8_t Clrscr[] = { 0x00, (uint8_t)(0xB0 + row), (uint8_t)(0x00 | (col & 0x0F)), (uint8_t)(0x10 | (col >> 4))};
	HAL_I2C_Master_Transmit(OLED_hi2c, DevAdd, (uint8_t *)Clrscr, sizeof(Clrscr), 500);
	uint8_t ClrByte[] = {0x40, 0x00};
	for (int i = col; i < 128; i++) {
			HAL_I2C_Master_Transmit(OLED_hi2c, DevAdd, (uint8_t *)ClrByte, sizeof(ClrByte), 500);
		}
}

void OLED_PrintInt(int16_t val, uint8_t row, uint8_t col) {
    char buf[7];
    sprintf(buf, "%d", val); // Supports negatives, any number of digits up to 32-bit
    OLED_Print(buf, row, col);
}
